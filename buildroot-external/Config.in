## buildroot-external/Config.in
```kconfig
menu "Sooperlooper"
source "$BR2_EXTERNAL_REDLOOPER_PATH/package/sooperlooper/Config.in"
source "$BR2_EXTERNAL_REDLOOPER_PATH/package/rubberband/Config.in"
source "$BR2_EXTERNAL_REDLOOPER_PATH/package/libsigc2/Config.in"
endmenu

source "$BR2_EXTERNAL_REDLOOPER_PATH/package/python-redlooper-app/Config.in"
source "$BR2_EXTERNAL_REDLOOPER_PATH/package/python-pyliblo/Config.in"
source "$BR2_EXTERNAL_REDLOOPER_PATH/package/python-jackclient/Config.in"
source "$BR2_EXTERNAL_REDLOOPER_PATH/package/python-pygame-gui/Config.in"
```

## buildroot-external/package/python-jackclient/Config.in
```kconfig
config BR2_PACKAGE_PYTHON_JACKCLIENT
	bool "python-jackclient"
	select BR2_PACKAGE_PYTHON3_CFFI
	select BR2_PACKAGE_PYTHON_CFFI


	help
	  JACK Audio Connection Kit (JACK) Client for Python

	  This Python module (named jack) provides bindings for the JACK library.
```

## buildroot-external/package/python-pyliblo/Config.in
```kconfig
config BR2_PACKAGE_PYTHON_PYLIBLO
	bool "python-pyliblo"
	select BR2_PACKAGE_PYTHON3_CYTHON # runtime
	select BR2_PACKAGE_HOST_PYTHON_CYTHON
	help
	  pyliblo - Python bindings for the liblo OSC library

	  Python bindings for the liblo OSC library
```

## buildroot-external/package/python-redlooper-app/Config.in
```kconfig
config BR2_PACKAGE_PYTHON_REDLOOPER_APP
	bool "python-redlooper-app"
	select BR2_PACKAGE_PYTHON_PYGAME # runtime
	select BR2_PACKAGE_PYTHON_PYGAME_FONT
	select BR2_PACKAGE_SOOPERLOOPER
	select BR2_PACKAGE_PYTHON_PYLIBLO
	select BR2_PACKAGE_PYTHON_JACKCLIENT
	select BR2_PACKAGE_PYTHON_RPI_GPIO

	help
	  GUI application for the Redlooper

	  Provides a GUI for the looper as well as connecting to the buttons
```

## buildroot-external/package/rubberband/Config.in
```kconfig
config BR2_PACKAGE_RUBBERBAND
	bool "rubberband"

	help
		audio time-stretching and pitch-shifting library
```

## buildroot-external/package/sooperlooper/Config.in
```kconfig
config BR2_PACKAGE_SOOPERLOOPER
	bool "sooperlooper"
	select BR2_PACKAGE_LIBLO
	select BR2_PACKAGE_LIBSIGC
	select BR2_PACKAGE_LIBXML2
	select BR2_PACKAGE_LIBSNDFILE
	select BR2_PACKAGE_NCURSES
	select BR2_PACKAGE_JACK2
	select BR2_PACKAGE_FFTW
	select BR2_PACKAGE_RUBBERBAND
	select BR2_PACKAGE_MUSL_FTS
	select BR2_PACKAGE_LIBSIGC2
	help
		SooperLooper -- Live Looping Sampler
```
